## config/Kconfig.defconfig
```kconfig
if SHIELD_CO_LEFT

config ZMK_KEYBOARD_NAME
	default "Co"

config ZMK_SPLIT_ROLE_CENTRAL
	default y

endif

if SHIELD_CO_LEFT || SHIELD_CO_RIGHT

config ZMK_SPLIT
	default y

endif
```
